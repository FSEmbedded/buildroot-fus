## configs/fsimx6sx_min_defconfig
```kconfig
BR2_arm=y
BR2_cortex_a9=y
BR2_ARM_ENABLE_NEON=y
BR2_ARM_ENABLE_VFP=y
BR2_ARM_FPU_NEON=y
BR2_CCACHE=y
BR2_OPTIMIZE_3=y
BR2_TOOLCHAIN_BUILDROOT_CXX=y
BR2_PACKAGE_OVERRIDE_FILE="board/f+s/fsimx6sx/local-fsimx6sx.mk"
BR2_LINUX_KERNEL_NEEDS_HOST_OPENSSL=y
BR2_LINUX_KERNEL_CUSTOM_VERSION_VALUE="6.6.129"
BR2_PACKAGE_LIBTIRPC_RPCDB=y
BR2_PACKAGE_HOST_LINUX_HEADERS_CUSTOM_6_6=y
BR2_PACKAGE_LIBTIRPC=y
BR2_PACKAGE_HOST_GDB=y
BR2_TARGET_OPTIMIZATION="-pipe"
BR2_TARGET_GENERIC_HOSTNAME="fsimx6sx"
BR2_TARGET_GENERIC_ISSUE="Welcome to F+S i.MX6SoloX"
BR2_ROOTFS_DEVICE_CREATION_DYNAMIC_EUDEV=y
BR2_ROOTFS_DEVICE_TABLE=""
BR2_TARGET_GENERIC_GETTY_PORT="login_tty"
# BR2_TARGET_GENERIC_REMOUNT_ROOTFS_RW is not set
BR2_ROOTFS_POST_BUILD_SCRIPT="board/f+s/fsimx6/finalscript_min-fsimx6sx"
BR2_LINUX_KERNEL=y
BR2_LINUX_KERNEL_CUSTOM_VERSION=y
BR2_LINUX_KERNEL_DEFCONFIG="fsimx6sx"
BR2_LINUX_KERNEL_DTS_SUPPORT=y
BR2_LINUX_KERNEL_INTREE_DTS_NAME="fus/efusa9x fus/efusa9xr2 fus/picocoma9x fus/picocoremx6sx fus/picocoremx6sxr2 fus/cont1 fus/vand3 fus/vc600"
BR2_PACKAGE_BUSYBOX_CONFIG="board/f+s/common/busybox-1.36.1.config"
BR2_PACKAGE_BUSYBOX_SHOW_OTHERS=y
# BR2_PACKAGE_EUDEV_ENABLE_HWDB is not set
BR2_PACKAGE_FREESCALE_IMX=y
BR2_PACKAGE_FREESCALE_IMX_PLATFORM_IMX6S=y
BR2_PACKAGE_FIRMWARE_IMX=y
BR2_PACKAGE_IPROUTE2=y
BR2_PACKAGE_KMOD_TOOLS=y
BR2_PACKAGE_UTIL_LINUX_UUIDD=y
BR2_TARGET_ROOTFS_EXT2=y
BR2_TARGET_ROOTFS_EXT2_4=y
BR2_TARGET_ROOTFS_EXT2_SIZE="22000"
# BR2_TARGET_ROOTFS_TAR is not set
BR2_TARGET_ROOTFS_UBIFS=y
BR2_TARGET_ROOTFS_UBIFS_LEBSIZE=0x1f000
BR2_TARGET_UBOOT=y
BR2_TARGET_UBOOT_BUILD_SYSTEM_KCONFIG=y
BR2_TARGET_UBOOT_CUSTOM_VERSION=y
BR2_TARGET_UBOOT_CUSTOM_VERSION_VALUE="2021.04"
BR2_TARGET_UBOOT_BOARD_DEFCONFIG="fsimx6sx"
BR2_TARGET_UBOOT_FORMAT_CUSTOM=y
BR2_TARGET_UBOOT_FORMAT_CUSTOM_NAME="uboot.nb0"
BR2_PACKAGE_HOST_GENIMAGE=y
BR2_PACKAGE_HOST_UBOOT_TOOLS=y
BR2_PACKAGE_HOST_MTOOLS=y
BR2_ROOTFS_POST_IMAGE_SCRIPT="board/f+s/common/post-image.sh"
BR2_ROOTFS_POST_SCRIPT_ARGS="${BR2_TARGET_GENERIC_HOSTNAME}"
```

## configs/fsimx6ul_min_defconfig
```kconfig
BR2_arm=y
BR2_cortex_a7=y
BR2_ARM_FPU_NEON_VFPV4=y
BR2_CCACHE=y
BR2_OPTIMIZE_3=y
BR2_TOOLCHAIN_BUILDROOT_CXX=y
BR2_PACKAGE_OVERRIDE_FILE="board/f+s/fsimx6ul/local-fsimx6ul.mk"
BR2_LINUX_KERNEL_NEEDS_HOST_OPENSSL=y
BR2_PACKAGE_LIBTIRPC_RPCDB=y
BR2_PACKAGE_LIBTIRPC=y
BR2_PACKAGE_HOST_GDB=y
BR2_TARGET_OPTIMIZATION="-pipe"
BR2_TARGET_GENERIC_HOSTNAME="fsimx6ul"
BR2_TARGET_GENERIC_ISSUE="Welcome to F+S i.MX6UL"
BR2_ROOTFS_DEVICE_CREATION_DYNAMIC_EUDEV=y
BR2_ROOTFS_DEVICE_TABLE=""
BR2_TARGET_GENERIC_GETTY_PORT="login_tty"
# BR2_TARGET_GENERIC_REMOUNT_ROOTFS_RW is not set
BR2_ROOTFS_POST_BUILD_SCRIPT="board/f+s/fsimx6/finalscript_min-fsimx6ul"
BR2_LINUX_KERNEL=y
BR2_LINUX_KERNEL_CUSTOM_VERSION=y
BR2_LINUX_KERNEL_CUSTOM_VERSION_VALUE="6.6.129"
BR2_PACKAGE_HOST_LINUX_HEADERS_CUSTOM_6_6=y
BR2_LINUX_KERNEL_DEFCONFIG="fsimx6ul"
BR2_LINUX_KERNEL_DTS_SUPPORT=y
BR2_LINUX_KERNEL_INTREE_DTS_NAME="fus/efusa7ul fus/efusa7ull fus/picocom1.2 fus/picocoma7 fus/picocoma7ull fus/picocoremx6ul fus/picocoremx6ull fus/picocoremx6ul100 fus/picocoremx6ull100 fus/gar1 fus/gar2 fus/gar3"
BR2_PACKAGE_BUSYBOX_CONFIG="board/f+s/common/busybox-1.36.1.config"
BR2_PACKAGE_BUSYBOX_SHOW_OTHERS=y
# BR2_PACKAGE_EUDEV_ENABLE_HWDB is not set
BR2_PACKAGE_FREESCALE_IMX=y
BR2_PACKAGE_FREESCALE_IMX_PLATFORM_IMX6UL=y
BR2_PACKAGE_FIRMWARE_IMX=y
BR2_PACKAGE_IPROUTE2=y
BR2_PACKAGE_KMOD_TOOLS=y
BR2_PACKAGE_UTIL_LINUX_UUIDD=y
BR2_TARGET_ROOTFS_EXT2=y
BR2_TARGET_ROOTFS_EXT2_4=y
BR2_TARGET_ROOTFS_EXT2_SIZE="20000"
# BR2_TARGET_ROOTFS_TAR is not set
BR2_TARGET_ROOTFS_UBIFS=y
BR2_TARGET_ROOTFS_UBIFS_LEBSIZE=0x1f000
BR2_TARGET_UBOOT=y
BR2_TARGET_UBOOT_BUILD_SYSTEM_KCONFIG=y
BR2_TARGET_UBOOT_CUSTOM_VERSION=y
BR2_TARGET_UBOOT_CUSTOM_VERSION_VALUE="2021.04"
BR2_TARGET_UBOOT_BOARD_DEFCONFIG="fsimx6ul"
BR2_TARGET_UBOOT_FORMAT_CUSTOM=y
BR2_TARGET_UBOOT_FORMAT_CUSTOM_NAME="uboot.nb0"
BR2_PACKAGE_HOST_GENIMAGE=y
BR2_PACKAGE_HOST_UBOOT_TOOLS=y
BR2_PACKAGE_HOST_MTOOLS=y
BR2_ROOTFS_POST_IMAGE_SCRIPT="board/f+s/common/post-image.sh"
BR2_ROOTFS_POST_SCRIPT_ARGS="${BR2_TARGET_GENERIC_HOSTNAME}"
```

## configs/fsimx8mm_min_defconfig
```kconfig
BR2_aarch64=y
BR2_ARM_FPU_VFPV3=y
BR2_CCACHE=y
BR2_OPTIMIZE_3=y
BR2_TOOLCHAIN_BUILDROOT_CXX=y
BR2_PACKAGE_OVERRIDE_FILE="board/f+s/fsimx8mm/local-fsimx8mm.mk"
BR2_LINUX_KERNEL_NEEDS_HOST_OPENSSL=y
BR2_LINUX_KERNEL_CUSTOM_VERSION_VALUE="6.6.129"
BR2_PACKAGE_LIBTIRPC_RPCDB=y
BR2_PACKAGE_HOST_LINUX_HEADERS_CUSTOM_6_6=y
BR2_PACKAGE_LIBTIRPC=y
BR2_PACKAGE_HOST_GDB=y
BR2_TARGET_OPTIMIZATION="-pipe"
BR2_TARGET_GENERIC_HOSTNAME="fsimx8mm"
BR2_TARGET_GENERIC_ISSUE="Welcome to F+S i.MX8MM"
BR2_ROOTFS_DEVICE_CREATION_DYNAMIC_EUDEV=y
BR2_ROOTFS_DEVICE_TABLE=""
BR2_TARGET_GENERIC_GETTY_PORT="login_tty"
# BR2_TARGET_GENERIC_REMOUNT_ROOTFS_RW is not set
BR2_ROOTFS_POST_BUILD_SCRIPT="board/f+s/fsimx8mm/finalscript_min-fsimx8mm"
BR2_LINUX_KERNEL=y
BR2_LINUX_KERNEL_CUSTOM_VERSION=y
BR2_LINUX_KERNEL_DEFCONFIG="fsimx8mm"
BR2_LINUX_KERNEL_DTS_SUPPORT=y
BR2_LINUX_KERNEL_INTREE_DTS_NAME=" F+S/picocoremx8mm-lpddr4 F+S/picocoremx8mm-lpddr4-lcdif-tc358775-j070wvtc0211 F+S/picocoremx8mm-lpddr4-lcdif-adp-mipi2mipi1-ee0350et-2cp F+S/picocoremx8mm-lpddr4-tc358775-BT070L1060CS0I1AD-A F+S/picocoremx8mm-lpddr4-lcdif-adp-mipi2rgb F+S/picocoremx8mmr2-lpddr4 F+S/picocoremx8mmr2-lpddr4-lcdif-tc358775-j070wvtc0211 F+S/picocoremx8mmr2-lpddr4-lcdif-adp-mipi2mipi1-ee0350et-2cp F+S/picocoremx8mmr2-lpddr4-lcdif-adp-mipi2rgb F+S/picocoremx8mmr2-lpddr4-tc358775-BT070L1060CS0I1AD-A F+S/picocoremx8mm-ddr3l F+S/picocoremx8mm-ddr3l-lcdif-tc358775-j070wvtc0211 F+S/picocoremx8mm-ddr3l-lcdif-adp-mipi2mipi1-ee0350et-2cp F+S/picocoremx8mm-ddr3l-lcdif-adp-mipi2rgb F+S/picocoremx8mm-ddr3l-tc358775-BT070L1060CS0I1AD-A F+S/osm8mm F+S/osm8mm-lcdif-adp-mipi2mipi1-ee0350et-2cp F+S/osm8mm-lcdif-adp-mipi2lvds1-BT070L1060CS0I1AD-A"
BR2_PACKAGE_BUSYBOX_CONFIG="board/f+s/common/busybox-1.36.1.config"
BR2_PACKAGE_BUSYBOX_SHOW_OTHERS=y
BR2_PACKAGE_IPROUTE2=y
BR2_PACKAGE_KMOD_TOOLS=y
BR2_TARGET_ROOTFS_EXT2=y
BR2_TARGET_ROOTFS_EXT2_4=y
BR2_TARGET_ROOTFS_EXT2_SIZE="140000"
# BR2_TARGET_ROOTFS_TAR is not set
BR2_TARGET_ROOTFS_UBIFS=y
BR2_TARGET_ROOTFS_UBIFS_LEBSIZE=0x1f000
BR2_TARGET_UBOOT=y
BR2_TARGET_UBOOT_BUILD_SYSTEM_KCONFIG=y
BR2_TARGET_UBOOT_CUSTOM_VERSION=y
BR2_TARGET_UBOOT_CUSTOM_VERSION_VALUE="2021.04"
BR2_TARGET_UBOOT_BOARD_DEFCONFIG="fsimx8mm"
BR2_TARGET_UBOOT_NEEDS_DTC=y
BR2_TARGET_UBOOT_FORMAT_CUSTOM=y
BR2_TARGET_UBOOT_FORMAT_CUSTOM_NAME="uboot.fs u-boot-dtb.img"
BR2_PACKAGE_HOST_DOSFSTOOLS=y
BR2_PACKAGE_HOST_GENIMAGE=y
BR2_PACKAGE_HOST_IMX_MKIMAGE=y
BR2_PACKAGE_HOST_MTOOLS=y
BR2_PACKAGE_HOST_UBOOT_TOOLS=y
BR2_PACKAGE_HOST_UBOOT_TOOLS_FIT_SUPPORT=y
BR2_PACKAGE_LINUX_FIRMWARE=y
BR2_PACKAGE_LINUX_FIRMWARE_MWIFIEX_SDSD8997=y
BR2_PACKAGE_LINUX_FIRMWARE_MWIFIEX_PCIEUSB8997=y
BR2_PACKAGE_FREESCALE_IMX=y
BR2_PACKAGE_FREESCALE_IMX_PLATFORM_IMX8MM=y
BR2_PACKAGE_FIRMWARE_IMX=y
BR2_ROOTFS_POST_IMAGE_SCRIPT="board/f+s/common/post-image.sh"
BR2_ROOTFS_POST_SCRIPT_ARGS="${BR2_TARGET_GENERIC_HOSTNAME}"
```
