## configs/fsimx6_qt6_defconfig
```kconfig
BR2_arm=y
BR2_cortex_a9=y
BR2_ARM_ENABLE_NEON=y
BR2_ARM_ENABLE_VFP=y
BR2_ARM_FPU_NEON=y
BR2_CCACHE=y
BR2_OPTIMIZE_3=y
BR2_TOOLCHAIN_BUILDROOT_CXX=y
BR2_PACKAGE_OVERRIDE_FILE="board/f+s/fsimx6/local-fsimx6.mk"
BR2_LINUX_KERNEL_NEEDS_HOST_OPENSSL=y
BR2_LINUX_KERNEL_CUSTOM_VERSION_VALUE="6.6.129"
BR2_PACKAGE_LIBTIRPC_RPCDB=y
BR2_PACKAGE_HOST_LINUX_HEADERS_CUSTOM_6_6=y
BR2_PACKAGE_LIBTIRPC=y
BR2_PACKAGE_HOST_GDB=y
BR2_TARGET_OPTIMIZATION="-pipe"
BR2_TARGET_GENERIC_HOSTNAME="fsimx6"
BR2_TARGET_GENERIC_ISSUE="Welcome to F+S i.MX6"
BR2_ROOTFS_DEVICE_CREATION_DYNAMIC_EUDEV=y
BR2_ROOTFS_DEVICE_TABLE=""
BR2_TARGET_GENERIC_GETTY_PORT="login_tty"
# BR2_TARGET_GENERIC_REMOUNT_ROOTFS_RW is not set
BR2_ROOTFS_POST_BUILD_SCRIPT="board/f+s/fsimx6/finalscript_std-fsimx6"
BR2_LINUX_KERNEL=y
BR2_LINUX_KERNEL_CUSTOM_VERSION=y
BR2_LINUX_KERNEL_DEFCONFIG="fsimx6"
BR2_LINUX_KERNEL_DTS_SUPPORT=y
BR2_LINUX_KERNEL_INTREE_DTS_NAME="F+S/efusa9dl F+S/efusa9q F+S/efusa9r2dl F+S/efusa9r2q F+S/armstonea9dl F+S/armstonea9q F+S/armstonea9r2dl F+S/armstonea9r2q F+S/armstonea9r3dl F+S/armstonea9r3q F+S/armstonea9r4dl F+S/armstonea9r4q F+S/picomoda9dl F+S/picomoda9q F+S/netdcua9dl F+S/netdcua9q F+S/qblissa9dl F+S/qblissa9q F+S/qblissa9r2dl F+S/qblissa9r2q"
BR2_PACKAGE_BUSYBOX_CONFIG="board/f+s/common/busybox-1.36.1.config"
BR2_PACKAGE_BUSYBOX_SHOW_OTHERS=y
BR2_PACKAGE_ALSA_UTILS=y
BR2_PACKAGE_ALSA_UTILS_AMIXER=y
BR2_PACKAGE_ALSA_UTILS_APLAY=y
BR2_PACKAGE_ALSA_UTILS_SPEAKER_TEST=y
BR2_PACKAGE_IMX_GSTREAMER1=y
BR2_PACKAGE_IMX_GST1_PLUGINS_BASE_PLUGIN_APP=y
BR2_PACKAGE_IMX_GST1_PLUGINS_BASE_PLUGIN_AUDIORATE=y
BR2_PACKAGE_IMX_GST1_PLUGINS_BASE_PLUGIN_AUDIOTESTSRC=y
BR2_PACKAGE_IMX_GST1_PLUGINS_BASE_PLUGIN_ENCODING=y
BR2_PACKAGE_IMX_GST1_PLUGINS_BASE_PLUGIN_VIDEOCONVERT=y
BR2_PACKAGE_IMX_GST1_PLUGINS_BASE_PLUGIN_RAWPARSE=y
BR2_PACKAGE_IMX_GST1_PLUGINS_BASE_PLUGIN_TCP=y
BR2_PACKAGE_IMX_GST1_PLUGINS_BASE_PLUGIN_VIDEOTESTSRC=y
BR2_PACKAGE_IMX_GST1_PLUGINS_BASE_PLUGIN_VIDEORATE=y
BR2_PACKAGE_IMX_GST1_PLUGINS_BASE_PLUGIN_ALSA=y
BR2_PACKAGE_IMX_GST1_PLUGINS_BASE_PLUGIN_OGG=y
BR2_PACKAGE_IMX_GST1_PLUGINS_BASE_PLUGIN_THEORA=y
BR2_PACKAGE_IMX_GST1_PLUGINS_BASE_PLUGIN_VORBIS=y
BR2_PACKAGE_IMX_GST1_PLUGINS_GOOD=y
BR2_PACKAGE_IMX_GST1_PLUGINS_GOOD_JPEG=y
BR2_PACKAGE_IMX_GST1_PLUGINS_GOOD_PNG=y
BR2_PACKAGE_IMX_GST1_PLUGINS_GOOD_PLUGIN_ALPHA=y
BR2_PACKAGE_IMX_GST1_PLUGINS_GOOD_PLUGIN_AUDIOPARSERS=y
BR2_PACKAGE_IMX_GST1_PLUGINS_GOOD_PLUGIN_AUTODETECT=y
BR2_PACKAGE_IMX_GST1_PLUGINS_GOOD_PLUGIN_DEINTERLACE=y
BR2_PACKAGE_IMX_GST1_PLUGINS_GOOD_PLUGIN_ID3DEMUX=y
BR2_PACKAGE_IMX_GST1_PLUGINS_GOOD_PLUGIN_UDP=y
BR2_PACKAGE_IMX_GST1_PLUGINS_GOOD_PLUGIN_VIDEOBOX=y
BR2_PACKAGE_IMX_GST1_PLUGINS_GOOD_PLUGIN_VIDEOCROP=y
BR2_PACKAGE_IMX_GST1_PLUGINS_GOOD_PLUGIN_VIDEOMIXER=y
BR2_PACKAGE_IMX_GST1_PLUGINS_GOOD_PLUGIN_WAVENC=y
BR2_PACKAGE_IMX_GST1_PLUGINS_GOOD_PLUGIN_V4L2=y
BR2_PACKAGE_IMX_GST1_PLUGINS_GOOD_PLUGIN_CAIRO=y
BR2_PACKAGE_IMX_GST1_PLUGINS_GOOD_PLUGIN_GDKPIXBUF=y
BR2_PACKAGE_IMX_GST1_PLUGINS_BAD_PLUGIN_AUDIOMIXER=y
BR2_PACKAGE_IMX_GST1_PLUGINS_BAD_PLUGIN_COMPOSITOR=y
BR2_PACKAGE_IMX_GST1_PLUGINS_BAD_PLUGIN_AUTOCONVERT=y
BR2_PACKAGE_IMX_GST1_PLUGINS_BAD_PLUGIN_JPEGFORMAT=y
BR2_PACKAGE_IMX_GST1_PLUGINS_BAD_PLUGIN_MPEGDEMUX=y
BR2_PACKAGE_IMX_GST1_PLUGINS_BAD_PLUGIN_MPEGTSDEMUX=y
BR2_PACKAGE_IMX_GST1_PLUGINS_BAD_PLUGIN_MPEGTSMUX=y
BR2_PACKAGE_IMX_GST1_PLUGINS_BAD_PLUGIN_MPEGPSMUX=y
BR2_PACKAGE_IMX_GST1_PLUGINS_BAD_PLUGIN_VIDEOPARSERS=y
BR2_PACKAGE_IMX_GST1_PLUGINS_BAD_PLUGIN_FBDEV=y
BR2_PACKAGE_IMX_GST1_PLUGIN=y
BR2_PACKAGE_MADPLAY=y
BR2_PACKAGE_GDB=y
BR2_PACKAGE_LMBENCH=y
BR2_PACKAGE_LTRACE=y
BR2_PACKAGE_STRACE=y
BR2_PACKAGE_CMAKE_CTEST=y
BR2_PACKAGE_DOSFSTOOLS=y
BR2_PACKAGE_DOSFSTOOLS_FATLABEL=y
BR2_PACKAGE_DOSFSTOOLS_FSCK_FAT=y
BR2_PACKAGE_DOSFSTOOLS_MKFS_FAT=y
BR2_PACKAGE_E2FSPROGS=y
BR2_PACKAGE_LIBERATION=y
BR2_PACKAGE_FBDUMP=y
BR2_PACKAGE_FBV=y
BR2_PACKAGE_PSPLASH=y
BR2_PACKAGE_CONFIG_PSPLASH=y
BR2_PACKAGE_PSPLASH_IMAGE="board/f+s/common/FS-Logo-256px.png"
BR2_PACKAGE_QT6_ARCH_SUPPORTS=y
BR2_PACKAGE_QT6_GL_SUPPORTS=y
BR2_PACKAGE_QT6=y
BR2_PACKAGE_QT6BASE=y
BR2_PACKAGE_QT6BASE_CONCURRENT=y
BR2_PACKAGE_QT6BASE_DBUS=y
BR2_PACKAGE_QT6BASE_GUI=y
BR2_PACKAGE_QT6BASE_LINUXFB=y
BR2_PACKAGE_QT6BASE_DEFAULT_QPA="eglfs"
BR2_PACKAGE_QT6BASE_OPENGL=y
BR2_PACKAGE_QT6BASE_OPENGL_ES2=y
BR2_PACKAGE_QT6BASE_FONTCONFIG=y
BR2_PACKAGE_QT6BASE_HARFBUZZ=y
BR2_PACKAGE_QT6BASE_GIF=y
BR2_PACKAGE_QT6BASE_JPEG=y
BR2_PACKAGE_QT6BASE_PNG=y
BR2_PACKAGE_QT6BASE_WIDGETS=y
BR2_PACKAGE_QT6BASE_NETWORK=y
BR2_PACKAGE_QT6BASE_XML=y
BR2_PACKAGE_QT6MULTIMEDIA=y
BR2_PACKAGE_QT6SERIALBUS=y
BR2_PACKAGE_QT6SERIALPORT=y
BR2_PACKAGE_QT6SHADERTOOLS=y
BR2_PACKAGE_QT6TOOLS=y
BR2_PACKAGE_QT6WEBSOCKETS=y
BR2_PACKAGE_LINUX_FIRMWARE=y
BR2_PACKAGE_LINUX_FIRMWARE_MWIFIEX_SD8787=y
BR2_PACKAGE_LINUX_FIRMWARE_MWIFIEX_PCIEUSB8997=y
BR2_PACKAGE_LINUX_FIRMWARE_TI_WL127X=y
BR2_PACKAGE_TOUCH_FIRMWARE=y
BR2_PACKAGE_FREESCALE_IMX=y
BR2_PACKAGE_FREESCALE_IMX_PLATFORM_IMX6Q=y
BR2_PACKAGE_IMX_ALSA_PLUGINS=y
BR2_PACKAGE_IMX_CODEC=y
BR2_PACKAGE_IMX_LIB=y
BR2_PACKAGE_IMX_PARSER=y
BR2_PACKAGE_IMX_VPUWRAP=y
BR2_PACKAGE_IMX_GPU_G2D=y
BR2_PACKAGE_IMX_GPU_VIV_OUTPUT_FB=y
BR2_PACKAGE_KBD=y
BR2_PACKAGE_LINUXCONSOLETOOLS=y
BR2_PACKAGE_PCIUTILS=y
BR2_PACKAGE_SPI_TOOLS=y
BR2_PACKAGE_TI_UTILS=y
# BR2_PACKAGE_ALSA_LIB_RAWMIDI is not set
# BR2_PACKAGE_ALSA_LIB_HWDEP is not set
# BR2_PACKAGE_ALSA_LIB_UCM is not set
# BR2_PACKAGE_ALSA_LIB_ALISP is not set
# BR2_PACKAGE_ALSA_LIB_OLD_SYMBOLS is not set
BR2_PACKAGE_LIBDRM_VIVANTE=y
BR2_PACKAGE_LIBPCIACCESS=y
BR2_PACKAGE_LIBUSB=y
BR2_PACKAGE_LIBV4L=y
BR2_PACKAGE_LIBV4L_UTILS=y
BR2_PACKAGE_MTDEV=y
BR2_PACKAGE_LIBIMXVPUAPI=y
BR2_PACKAGE_LIBEVDEV=y
BR2_PACKAGE_CAN_UTILS=y
BR2_PACKAGE_ETHTOOL=y
BR2_PACKAGE_IPROUTE2=y
BR2_PACKAGE_IW=y
BR2_PACKAGE_OPENSSH=y
BR2_PACKAGE_WPA_SUPPLICANT=y
BR2_PACKAGE_WPA_SUPPLICANT_AP_SUPPORT=y
BR2_PACKAGE_WPA_SUPPLICANT_EAP=y
BR2_PACKAGE_WPA_SUPPLICANT_WPS=y
BR2_PACKAGE_WPA_SUPPLICANT_CLI=y
BR2_PACKAGE_WPA_SUPPLICANT_PASSPHRASE=y
BR2_PACKAGE_WIRELESS_REGDB=y
BR2_PACKAGE_KMOD_TOOLS=y
BR2_PACKAGE_LIBGPIOD2=y
BR2_PACKAGE_LIBGPIOD2_TOOLS=y
BR2_TARGET_ROOTFS_EXT2=y
BR2_TARGET_ROOTFS_EXT2_4=y
BR2_TARGET_ROOTFS_EXT2_SIZE="400000"
# BR2_TARGET_ROOTFS_TAR is not set
BR2_TARGET_ROOTFS_UBIFS=y
BR2_TARGET_ROOTFS_UBIFS_LEBSIZE=0x1f000
BR2_TARGET_UBOOT=y
BR2_TARGET_UBOOT_BUILD_SYSTEM_KCONFIG=y
BR2_TARGET_UBOOT_CUSTOM_VERSION=y
BR2_TARGET_UBOOT_CUSTOM_VERSION_VALUE="2021.04"
BR2_TARGET_UBOOT_BOARD_DEFCONFIG="fsimx6"
BR2_TARGET_UBOOT_FORMAT_CUSTOM=y
BR2_TARGET_UBOOT_FORMAT_CUSTOM_NAME="uboot.nb0"
BR2_PACKAGE_HOST_GENIMAGE=y
BR2_PACKAGE_HOST_UBOOT_TOOLS=y
BR2_PACKAGE_HOST_MTOOLS=y
BR2_ROOTFS_POST_IMAGE_SCRIPT="board/f+s/common/post-image.sh"
BR2_ROOTFS_POST_SCRIPT_ARGS="${BR2_TARGET_GENERIC_HOSTNAME}"
```
